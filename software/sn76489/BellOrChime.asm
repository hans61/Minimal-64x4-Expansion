; 10  REM ** BELL OR CHIME **
; 20  N=7; REM PORT NUMBER OF SN76489
; 30  OUT N, 159; REM TURN OFF TONE 1
; 40  OUT N, 191; REM TURN OFF TONE 3
; 50  OUT N, 223; REM TURN OFF TONE 4
; 60  OUT N, 255; REM TURN OFF NOISE
; 70  OUT N, 140; REM TONE 1 AT 679HZ
; 80  OUT N, 5
; 90  OUT N, 170; REM TONE 2 AT 694HZ
; 100 OUT N, 5
; 110 FOR B=0 TO 11; REM B=NUMBER OF BELLS
; 120 FOR I=145 TO 159; REM LOOP TO GENERATE VOLUME STEPS
; 130 OUT N, I; OUT N, (I+32); REM CHANGE VOLUME FOR TONE 1&2
; 140 FOR D=0 TO 75; NEXT D; REM DELAY LOOP
; 150 NEXT I
; 160 NEXT B
; 190 PRINT "END OF SOUND"


#org 0x2000
    MIB 0xfe,0xffff
start:
    ; MIB 0xff,outPort2
loop1:
    LDI 159 JAS wrSN76489   ; OFF TONE 1 0x9f
    LDI 191 JAS wrSN76489   ; OFF TONE 2 0xbf
    LDI 223 JAS wrSN76489   ; OFF TONE 3 0xdf
    LDI 255 JAS wrSN76489   ; TURN OFF NOISE 0xff
    LDI 140 JAS wrSN76489   ; TONE 1 AT 679HZ 0x8C ? 0x84=132
    LDI   5 JAS wrSN76489   ;
    LDI 170 JAS wrSN76489   ; TONE 2 AT 694HZ 0xaa
    LDI   5 JAS wrSN76489   ; 
    MIZ 0,varB              ; FOR B=0 TO 11
loopB:
    MIZ 145,varI            ; FOR I=145 TO 159
loopI:
    LDZ varI JAS wrSN76489          ; 145=0x91 159=0x9f
    LDZ varI ADI 32 JAS wrSN76489   ; 145+32=177=0xb1 191=0xbf
    MIZ 114,regB JPS wait20ms
    INZ varI
    CPI 160
    BNE loopI
    INZ varB
    CPI 12
    BNE loopB
    LDI 159 JAS wrSN76489   ; OFF TONE 1 0x9f
    LDI 191 JAS wrSN76489   ; OFF TONE 2 0xbf
    LDI 223 JAS wrSN76489   ; OFF TONE 3 0xdf
    LDI 255 JAS wrSN76489   ; TURN OFF NOISE 0xff

    JPS _WaitInput
    JPA start
stop: JPA stop

;~~~~~~~~~~~~~~~~~~~~~~~~~~~~~~~~~ subroutines ~~~~~~~~~~~~~~~~~~~~~~~~~~~~~~~~~
delay_ms:
    PHS             ; 8
    JPS wait1ms
    PLS             ; 6
    DEC             ; 3
    BNE delay_ms    ; 4/3
    RTS             ; 
    
waitVsync:
    LDB vsync
    ANI 0x40
    CPI 0x00
    BEQ waitVsync   ; wait until high
vsync1:
    LDB vsync
    ANI 0x40
    CPI 0x00
    BNE vsync1
    RTS
    
wait1ms: MIZ 194,regA           ; 4 (*0,125µS=0,5µS)            -> (0,5+999,25+2,625)µS | 195~1002,375 194~997,25µS
w1ms: NOP NOP DEZ regA BNE w1ms ; (32+5+4[3]) * 195 = 7994 = 999,25µS
    RTS                         ; 10 (+11 für JSR) = 2,625µS
;~~~~~~~~~~~~~~~~~~~~~~~~~~~~~~~~~~~~~~~~~~~~~~~~~~~~~~~~~~~~~~~~~~~~~~~~~~~~~~~
wait20ms:
    JPS waitVsync ; 16,67ms
    JPS wait1ms
    JPS wait1ms
    RTS
;~~~~~~~~~~~~~~~~~~~~~~~~~~~~~~~~~~~~~~~~~~~~~~~~~~~~~~~~~~~~~~~~~~~~~~~~~~~~~~~
; write A to SN76489
wrSN76489:
    STB sn76489
    MIB 0x02,hc173  ; CLB rwLow
    NOP NOP NOP NOP ; (NOP = 2µS) the SN764898 requires 8µs at 4Mhz (16µs at 2Mhz)
    MIB 0x00,hc173  ; CLB rwHigh
    RTS
;~~~~~~~~~~~~~~~~~~~~~~~~~~~~~~~~~~~~~~~~~~~~~~~~~~~~~~~~~~~~~~~~~~~~~~~~~~~~~~~
SilenceAllChannels:
    LDI 0x9f JAS wrSN76489
    LDI 0xbf JAS wrSN76489
    LDI 0xdf JAS wrSN76489
    LDI 0xff JAS wrSN76489
    RTS
;~~~~~~~~~~~~~~~~~~~~~~~~~~~~~~~~~~~~~~~~~~~~~~~~~~~~~~~~~~~~~~~~~~~~~~~~~~~~~~~

#mute
#org 0x0000
regA: 0x00,
regB: 0x00,
varB: 0x00,
varI: 0x00,
FF1: 0x00,
c1: 0x00,
c2: 0x00,

#org 0xfee0 sn76489:    ; SN76489 data port (4HC574)
#org 0xfee1 vsync:      ; 4HC574 input Kempston vsync
#org 0xfee2 hc173:      ; bit 0 = 1 -> /CS = 0 | bit 0 = 0 -> /CS = 1
#org 0xfee3 spi:        ; address for reading and writing the spi shift register, writing starts the beat

#org 0x0001 _CS_ON:     ; /CS sd card on
#org 0x0000 _CS_OFF:    ; /CS sd card off

; MinOS API definitions generated by 'asm os.asm -s_'
#org 0xf000 _Start:
#org 0xf003 _Prompt:
#org 0xf006 _MemMove:
#org 0xf009 _Random:
#org 0xf00c _ScanPS2:
#org 0xf00f _ResetPS2:
#org 0xf012 _ReadInput:
#org 0xf015 _WaitInput:
#org 0xf018 _ReadLine:
#org 0xf01b _SkipSpace:
#org 0xf01e _ReadHex:
#org 0xf021 _SerialWait:
#org 0xf024 _SerialPrint:
#org 0xf027 _FindFile:
#org 0xf02a _LoadFile:
#org 0xf02d _SaveFile:
#org 0xf030 _ClearVRAM:
#org 0xf033 _Clear:
#org 0xf036 _ClearRow:
#org 0xf039 _ScrollUp:
#org 0xf03c _ScrollDn:
#org 0xf03f _Char:
#org 0xf042 _PrintChar:
#org 0xf045 _Print:
#org 0xf048 _PrintPtr:
#org 0xf04b _PrintHex:
#org 0xf04e _SetPixel:
#org 0xf051 _Line:
#org 0xf054 _Rect:

#org 0x00c0 _XPos:
#org 0x00c1 _YPos:
#org 0x00c2 _RandomState:
#org 0x00c6 _ReadNum:
#org 0x00c9 _ReadPtr:
#org 0x00cd _ReadBuffer: